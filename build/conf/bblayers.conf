## build/conf/local.conf
```bitbake
#
# This file is your local configuration file and is where all local user settings
# are placed. The comments in this file give some guide to the options a new user
# to the system might want to change but pretty much any configuration option can
# be set in this file. More adventurous users can look at local.conf.extended
# which contains other examples of configuration which can be placed in this file
# but new users likely won't need any of them initially.
#
# Lines starting with the '#' character are commented out and in some cases the
# default values are provided as comments to show people example syntax. Enabling
# the option is a question of removing the # character and making any change to the
# variable as required.

#
# Machine Selection
#
# You need to select a specific machine to target the build with. There are a selection
# of emulated machines available which can boot and run in the QEMU emulator:
#
#MACHINE ?= "qemuarm"
#MACHINE ?= "qemuarm64"
#MACHINE ?= "qemumips"
#MACHINE ?= "qemumips64"
#MACHINE ?= "qemuppc"
#MACHINE ?= "qemux86"
#MACHINE ?= "qemux86-64"
#
# There are also the following hardware board target machines included for 
# demonstration purposes:
#
#MACHINE ?= "beaglebone-yocto"
#MACHINE ?= "genericx86"
#MACHINE ?= "genericx86-64"
#MACHINE ?= "mpc8315e-rdb"
#MACHINE ?= "edgerouter"
#
# This sets the default machine to be qemux86-64 if no other machine is selected:
MACHINE ??= "qemux86-64"
MACHINE = "raspberrypi5"
#
# Where to place downloads
#
# During a first build the system will download many different source code tarballs
# from various upstream projects. This can take a while, particularly if your network
# connection is slow. These are all stored in DL_DIR. When wiping and rebuilding you
# can preserve this directory to speed up this part of subsequent builds. This directory
# is safe to share between multiple builds on the same machine too.
#
# The default is a downloads directory under TOPDIR which is the build directory.
#
#DL_DIR ?= "${TOPDIR}/downloads"

#
# Where to place shared-state files
#
# BitBake has the capability to accelerate builds based on previously built output.
# This is done using "shared state" files which can be thought of as cache objects
# and this option determines where those files are placed.
#
# You can wipe out TMPDIR leaving this directory intact and the build would regenerate
# from these files if no changes were made to the configuration. If changes were made
# to the configuration, only shared state files where the state was still valid would
# be used (done using checksums).
#
# The default is a sstate-cache directory under TOPDIR.
#
#SSTATE_DIR ?= "${TOPDIR}/sstate-cache"

#
# Where to place the build output
#
# This option specifies where the bulk of the building work should be done and
# where BitBake should place its temporary files and output. Keep in mind that
# this includes the extraction and compilation of many applications and the toolchain
# which can use Gigabytes of hard disk space.
#
# The default is a tmp directory under TOPDIR.
#
#TMPDIR = "${TOPDIR}/tmp"

#
# Default policy config
#
# The distribution setting controls which policy settings are used as defaults.
# The default value is fine for general Yocto project use, at least initially.
# Ultimately when creating custom policy, people will likely end up subclassing 
# these defaults.
#
DISTRO ?= "poky"
# As an example of a subclass there is a "bleeding" edge policy configuration
# where many versions are set to the absolute latest code from the upstream 
# source control systems. This is just mentioned here as an example, its not
# useful to most new users.
# DISTRO ?= "poky-bleeding"

#
# Package Management configuration
#
# This variable lists which packaging formats to enable. Multiple package backends
# can be enabled at once and the first item listed in the variable will be used
# to generate the root filesystems.
# Options are:
#  - 'package_deb' for debian style deb files
#  - 'package_ipk' for ipk files are used by opkg (a debian style embedded package manager)
#  - 'package_rpm' for rpm style packages
# E.g.: PACKAGE_CLASSES ?= "package_rpm package_deb package_ipk"
# We default to rpm:
PACKAGE_CLASSES ?= "package_rpm"

#
# SDK target architecture
#
# This variable specifies the architecture to build SDK items for and means
# you can build the SDK packages for architectures other than the machine you are
# running the build on (i.e. building i686 packages on an x86_64 host).
# Supported values are i686 and x86_64
#SDKMACHINE ?= "i686"

#
# Extra image configuration defaults
#
# The EXTRA_IMAGE_FEATURES variable allows extra packages to be added to the generated
# images. Some of these options are added to certain image types automatically. The
# variable can contain the following options:
#  "dbg-pkgs"       - add -dbg packages for all installed packages
#                     (adds symbol information for debugging/profiling)
#  "src-pkgs"       - add -src packages for all installed packages
#                     (adds source code for debugging)
#  "dev-pkgs"       - add -dev packages for all installed packages
#                     (useful if you want to develop against libs in the image)
#  "ptest-pkgs"     - add -ptest packages for all ptest-enabled packages
#                     (useful if you want to run the package test suites)
#  "tools-sdk"      - add development tools (gcc, make, pkgconfig etc.)
#  "tools-debug"    - add debugging tools (gdb, strace)
#  "eclipse-debug"  - add Eclipse remote debugging support
#  "tools-profile"  - add profiling tools (oprofile, lttng, valgrind)
#  "tools-testapps" - add useful testing tools (ts_print, aplay, arecord etc.)
#  "debug-tweaks"   - make an image suitable for development
#                     e.g. ssh root access has a blank password
# There are other application targets that can be used here too, see
# meta/classes/image.bbclass and meta/classes/core-image.bbclass for more details.
# We default to enabling the debugging tweaks.
EXTRA_IMAGE_FEATURES ?= "debug-tweaks"

#
# Additional image features
#
# The following is a list of additional classes to use when building images which
# enable extra features. Some available options which can be included in this variable
# are:
#   - 'buildstats' collect build statistics
USER_CLASSES ?= "buildstats"

#
# Runtime testing of images
#
# The build system can test booting virtual machine images under qemu (an emulator)
# after any root filesystems are created and run tests against those images. It can also
# run tests against any SDK that are built. To enable this uncomment these lines.
# See classes/test{image,sdk}.bbclass for further details.
#IMAGE_CLASSES += "testimage testsdk"
#TESTIMAGE_AUTO:qemuall = "1"

#
# Interactive shell configuration
#
# Under certain circumstances the system may need input from you and to do this it
# can launch an interactive shell. It needs to do this since the build is
# multithreaded and needs to be able to handle the case where more than one parallel
# process may require the user's attention. The default is iterate over the available
# terminal types to find one that works.
#
# Examples of the occasions this may happen are when resolving patches which cannot
# be applied, to use the devshell or the kernel menuconfig
#
# Supported values are auto, gnome, xfce, rxvt, screen, konsole (KDE 3.x only), none
# Note: currently, Konsole support only works for KDE 3.x due to the way
# newer Konsole versions behave
#OE_TERMINAL = "auto"
# By default disable interactive patch resolution (tasks will just fail instead):
PATCHRESOLVE = "noop"

#
# Disk Space Monitoring during the build
#
# Monitor the disk space during the build. If there is less that 1GB of space or less
# than 100K inodes in any key build location (TMPDIR, DL_DIR, SSTATE_DIR), gracefully
# shutdown the build. If there is less that 100MB or 1K inodes, perform a hard halt
# of the build. The reason for this is that running completely out of space can corrupt
# files and damages the build in ways which may not be easily recoverable.
# It's necesary to monitor /tmp, if there is no space left the build will fail
# with very exotic errors.
BB_DISKMON_DIRS ??= "\
    STOPTASKS,${TMPDIR},1G,100K \
    STOPTASKS,${DL_DIR},1G,100K \
    STOPTASKS,${SSTATE_DIR},1G,100K \
    STOPTASKS,/tmp,100M,100K \
    HALT,${TMPDIR},100M,1K \
    HALT,${DL_DIR},100M,1K \
    HALT,${SSTATE_DIR},100M,1K \
    HALT,/tmp,10M,1K"

#
# Shared-state files from other locations
#
# As mentioned above, shared state files are prebuilt cache data objects which can
# used to accelerate build time. This variable can be used to configure the system
# to search other mirror locations for these objects before it builds the data itself.
#
# This can be a filesystem directory, or a remote url such as http or ftp. These
# would contain the sstate-cache results from previous builds (possibly from other
# machines). This variable works like fetcher MIRRORS/PREMIRRORS and points to the
# cache locations to check for the shared objects.
# NOTE: if the mirror uses the same structure as SSTATE_DIR, you need to add PATH
# at the end as shown in the examples below. This will be substituted with the
# correct path within the directory structure.
#SSTATE_MIRRORS ?= "\
#file://.* http://someserver.tld/share/sstate/PATH;downloadfilename=PATH \n \
#file://.* file:///some/local/dir/sstate/PATH"

#
# AGL Project SState Mirror
#
# The AGL Project has prebuilt artefacts available for its releases, you can enable
# use of these by uncommenting the following line. This will mean the build uses
# the network to check for artefacts at the start of builds, which does slow it down
# equally, it will also speed up the builds by not having to build things if they are
# present in the cache. It assumes you can download something faster than you can build it
# which will depend on your network.
#
#SSTATE_MIRRORS ?= "file://.* http://sstate.yoctoproject.org/2.5/PATH;downloadfilename=PATH"
# For AGL:
#SSTATE_MIRRORS += "file://.* http://download.automotivelinux.org/sstate-mirror/${AGL_BRANCH}/${DEFAULTTUNE}/PATH;downloadfilename=PATH"

#
# Qemu configuration
#
# By default native qemu will build with a builtin VNC server where graphical output can be
# seen. The line below enables the SDL UI frontend too.
PACKAGECONFIG:append:pn-qemu-system-native = " sdl"
# By default libsdl2-native will be built, if you want to use your host's libSDL instead of 
# the minimal libsdl built by libsdl2-native then uncomment the ASSUME_PROVIDED line below.
#ASSUME_PROVIDED += "libsdl2-native"

# You can also enable the Gtk UI frontend, which takes somewhat longer to build, but adds
# a handy set of menus for controlling the emulator.
#PACKAGECONFIG:append:pn-qemu-system-native = " gtk+"

#
# Parallelism Options
#
# These two options control how much parallelism BitBake should use. The first
# option determines how many tasks bitbake should run in parallel:
#
#BB_NUMBER_THREADS ?= "4"
#
# Default to setting automatically based on cpu count
#BB_NUMBER_THREADS ?= "${@oe.utils.cpu_count()}"
#
# The second option controls how many processes make should run in parallel when
# running compile tasks:
#
#PARALLEL_MAKE ?= "-j 4"
#
# Default to setting automatically based on cpu count
#PARALLEL_MAKE ?= "-j ${@oe.utils.cpu_count()}"
#
# For a quad-core machine, BB_NUMBER_THREADS = "4", PARALLEL_MAKE = "-j 4" would
# be appropriate for example.

#
# Hash Equivalence
#
# Enable support for automatically running a local hash equivalence server and
# instruct bitbake to use a hash equivalence aware signature generator. Hash
# equivalence improves reuse of sstate by detecting when a given sstate
# artifact can be reused as equivalent, even if the current task hash doesn't
# match the one that generated the artifact.
#
# A shared hash equivalent server can be set with "<HOSTNAME>:<PORT>" format
#
# local only
#BB_HASHSERVE = "auto"
#BB_SIGNATURE_HANDLER = "OEEquivHash"
#
# online/upstream r/o
#AGL_HOST_HASHSERV = "prserv.automotivelinux.org"
#BB_SIGNATURE_HANDLER = "OEEquivHash"
#BB_HASHSERVE = "auto"
#BB_HASHSERVE_UPSTREAM = "${AGL_HOST_HASHSERV}:8888"

# The network based PR service host and port
# Uncomment the following lines to enable PRservice.
# Set PRSERV_HOST to 'localhost:0' to automatically
# start local PRService.
# Set to other values to use remote PRService.
#PRSERV_HOST = "localhost:0"
#
# r/o upstream prserv
#AGL_HOST_PRSERV = "prserv.automotivelinux.org"
#PRSERV_HOST = "prserv.automotivelinux.org:8686"


# Archive the source and put them to ${DEPLOY_DIR}/sources/.
#
#INHERIT += "archiver"
#
# The tarball for the patched source will be created by default, and you
# can configure the archiver as follow:
#
# Create archive for:
# 1) original (or unpacked) source:
#ARCHIVER_MODE[src] = "original"
# 2) patched source: (default)
#ARCHIVER_MODE[src] = "patched"
# 3) configured source:
#ARCHIVER_MODE[src] = "configured"
#
# 4) the patches between do_unpack and do_patch:
#ARCHIVER_MODE[diff] = "1"
# set the files that you'd like to exclude from the diff:
#ARCHIVER_MODE[diff-exclude] ?= ".pc autom4te.cache patches"
#
# 5) the environment data, similar to 'bitbake -e recipe':
#ARCHIVER_MODE[dumpdata] = "1"
#
# 6) the recipe (.bb and .inc):
#ARCHIVER_MODE[recipe] = "1"
#
# 7) Whether output the .src.rpm package:
#ARCHIVER_MODE[srpm] = "1"
#
# 8) Filter the license, the recipe whose license in
#    COPYLEFT_LICENSE_INCLUDE will be included, and in
#    COPYLEFT_LICENSE_EXCLUDE will be excluded.
#COPYLEFT_LICENSE_INCLUDE = 'GPL* LGPL*'
#COPYLEFT_LICENSE_EXCLUDE = 'CLOSED Proprietary'
#
# 9) Config the recipe type that will be archived, the type can be
#    target, native, nativesdk, cross, crosssdk and cross-canadian,
#    you can set one or more types. Archive all types by default.
#COPYLEFT_RECIPE_TYPES = 'target'
#


# CONF_VERSION is increased each time build/conf/ changes incompatibly and is used to
# track the version of this file when it was generated. This can safely be ignored if
# this doesn't mean anything to you.
CONF_VERSION = "2"

# # # # # # # # # # # # # # # # # # # # # # # # # # # # # # # # # # # # # # # #
# fragment { 
# /home/nesg/AGLinux/meta-agl/templates/base/00_local.conf.agl.inc
#
# AGL global configuration options
#---------------------------------

# Set DISTRO for AGL
DISTRO = "poky-agl"

#see meta-agl/meta-agl-profile-core/conf/include/base-agl.inc
require conf/include/base-agl.inc

#
# }
# # # # # # # # # # # # # # # # # # # # # # # # # # # # # # # # # # # # # # # #

# # # # # # # # # # # # # # # # # # # # # # # # # # # # # # # # # # # # # # # #
# fragment { 
# /home/nesg/AGLinux/./meta-agl/templates/machine/raspberrypi5/20_local.conf.inc
#
MACHINE = "raspberrypi5"

#see meta-agl/meta-agl-bsp/conf/include/agl_raspberrypi5.inc
require conf/include/agl_raspberrypi5.inc

#
# }
# # # # # # # # # # # # # # # # # # # # # # # # # # # # # # # # # # # # # # # #

# # # # # # # # # # # # # # # # # # # # # # # # # # # # # # # # # # # # # # # #
# fragment { 
# /home/nesg/AGLinux/meta-agl-demo/templates/feature/agl-demo/50_local.conf.inc
#
#see meta-agl-demo/conf/include/agl-demo.inc
require conf/include/agl-demo.inc

#
# }
# # # # # # # # # # # # # # # # # # # # # # # # # # # # # # # # # # # # # # # #

# # # # # # # # # # # # # # # # # # # # # # # # # # # # # # # # # # # # # # # #
# fragment { 
# /home/nesg/AGLinux/meta-agl/templates/feature/agl-app-framework/50_local.conf.inc
#
#see meta-agl/meta-app-framework/conf/include/agl-app-framework.inc
require conf/include/agl-app-framework.inc

#
# }
# # # # # # # # # # # # # # # # # # # # # # # # # # # # # # # # # # # # # # # #

# # # # # # # # # # # # # # # # # # # # # # # # # # # # # # # # # # # # # # # #
# fragment { 
# /home/nesg/AGLinux/meta-agl/templates/feature/agl-devel/50_local.conf.inc
#
#see meta-agl/meta-agl/conf/include/agl-devel.inc
require conf/include/agl-devel.inc

#
# }
# # # # # # # # # # # # # # # # # # # # # # # # # # # # # # # # # # # # # # # #

# # # # # # # # # # # # # # # # # # # # # # # # # # # # # # # # # # # # # # # #
# fragment { 
# /home/nesg/AGLinux/meta-agl/templates/feature/agl-flutter/50_local.conf.inc
#
# Include Flutter SDK in SDK
TOOLCHAIN_HOST_TASK:append = " nativesdk-flutter-sdk"

# Include agl-specific defaults
require conf/include/agl-flutter.inc

#
# }
# # # # # # # # # # # # # # # # # # # # # # # # # # # # # # # # # # # # # # # #

# # # # # # # # # # # # # # # # # # # # # # # # # # # # # # # # # # # # # # # #
# fragment { 
# /home/nesg/AGLinux/meta-agl/templates/feature/agl-kuksa-val/50_local.conf.inc
#
require conf/include/agl-kuksa-val.inc

#
# }
# # # # # # # # # # # # # # # # # # # # # # # # # # # # # # # # # # # # # # # #

# # # # # # # # # # # # # # # # # # # # # # # # # # # # # # # # # # # # # # # #
# fragment { 
# /home/nesg/AGLinux/meta-agl/templates/feature/agl-package-management/50_local.conf.inc
#
#see meta-agl/meta-agl/conf/include/agl-package-management.inc
require conf/include/agl-package-management.inc

#
# }
# # # # # # # # # # # # # # # # # # # # # # # # # # # # # # # # # # # # # # # #

# # # # # # # # # # # # # # # # # # # # # # # # # # # # # # # # # # # # # # # #
# fragment { 
# /home/nesg/AGLinux/meta-agl/templates/feature/agl-pipewire/50_local.conf.inc
#
#see meta-agl-devel/meta-pipewire/conf/include/agl-pipewire.inc
require conf/include/agl-pipewire.inc

#
# }
# # # # # # # # # # # # # # # # # # # # # # # # # # # # # # # # # # # # # # # #

# # # # # # # # # # # # # # # # # # # # # # # # # # # # # # # # # # # # # # # #
# fragment { 
# /home/nesg/AGLinux/meta-agl/templates/feature/agl-selinux/50_local.conf.inc
#
#see meta-agl/meta-agl/conf/include/agl-selinux.inc
require conf/include/agl-selinux.inc

#
# }
# # # # # # # # # # # # # # # # # # # # # # # # # # # # # # # # # # # # # # # #

# # # # # # # # # # # # # # # # # # # # # # # # # # # # # # # # # # # # # # # #
# fragment { 
# /home/nesg/AGLinux/meta-agl/templates/base/99_local.conf.inc
#
########################
# AGL DISTRO VARIABLES #
########################

# ARM 32bit 'medium' compiler (armv7thf instead of armv7ve)
# (only use for CPUs <= cortex-a9 / w/o virt extension - e.g. cortex-a8)
# AGL_FEATURES:append = " agl-medium-arm-compiler"


######################
# AGL USER VARIABLES #
######################

# Add additional IMAGE_FSTYPES here on-top of the default ext4.xz and tar.xz
#AGL_EXTRA_IMAGE_FSTYPES = ""

# Additional free disk space created in the image in Kbytes.
#IMAGE_ROOTFS_EXTRA_SPACE="524288"

# meta-agl/meta-agl-profile-graphical/recipes-graphics/wayland/weston-init.bbappend
# AGL's compositor is started instead of weston like so
# AGL_DEFAULT_WESTONSTART ?= "/usr/bin/agl-compositor --config ${sysconfdir}/xdg/weston/weston.ini"
# you can redefine it using this variable to go back to weston,
# but be careful that this needs further changes to work !
# Especially the AGL demo apps will not work as-is.
#AGL_DEFAULT_WESTONSTART = "/usr/bin/weston"

# meta-agl-profile-graphical-qt5/recipes-qt/qt5/qtwayland_%.bbappend
# This defines the QT integration. We default to xdg-shell
# AGL_DEFAULT_WM_SHELL ?= "xdg-shell"
# you can redefine it using this variable to e.g. use ivi-shell
# but be careful that this needs further changes to work !
#AGL_DEFAULT_WM_SHELL = ""

#
# }
# # # # # # # # # # # # # # # # # # # # # # # # # # # # # # # # # # # # # # # #

# # # # # # # # # # # # # # # # # # # # # # # # # # # # # # # # # # # # # # # #
# fragment { 
# /dev/stdin
#
# generated by /home/nesg/AGLinux/meta-agl/scripts/.aglsetup_genconfig.bash
DISTRO_SETUP_MANIFEST = "/home/nesg/AGLinux/build/aglsetup.manifest"
DISTRO_MANIFEST_GENERATOR = "/home/nesg/AGLinux/meta-agl/scripts/distro-manifest-generator.sh"

IMAGE_FEATURES:append = " splash"
MACHINE_FEATURES:append = " wifi"
IMAGE_INSTALL:append = " linux-firmware-rpidistro-bcm43455 wpa-supplicant"
IMAGE_INSTALL:append= " connman-provision plymouth gstreamer1.0-plugins-bad gstreamer1.0-plugins-good agl-mirror light drivemode steering server hvac social \
                       navigation mediaplayer settings phone phoBert VieNeuTTS sherpa-onnx zipformer wakeword wakeword-models piper-tts rnnoise llama.cpp-server llama.cpp-cli assistant \
                       pipewire wireplumber pipewire-pulse pipewire-modules-protocol-native bluez5-obex bluez5-noinst-tools \
                       gstreamer1.0 gstreamer1.0-plugins-base gstreamer1.0-plugins-good gstreamer1.0-plugins-bad gstreamer1.0-libav qtmultimedia-plugins mpv qtwebengine-qmlplugins \
                       vulkan-loader mesa-vulkan-drivers vulkan-tools htop \
"



LICENSE_FLAGS_ACCEPTED:append = " commercial"
DISABLE_SPLASH = "1"
PACKAGECONFIG:append:pn-plymouth = " drm kms"
PACKAGECONFIG:append:pn-gstreamer1.0-plugins-bad = " v4l2codecs kms"
PACKAGECONFIG:append:pn-pipewire = " pulseaudio"
PACKAGECONFIG:append:pn-qtmultimedia = " gstreamer alsa"
PACKAGECONFIG:remove:pn-qtmultimedia = "pulseaudio ffmpeg"
PACKAGECONFIG:append:pn-gstreamer1.0-plugins-base = " alsa"


RPI_EXTRA_CONFIG:append = "enable_uart=1\n"
RPI_EXTRA_CONFIG:append = "dtparam=pciex1_gen=3\n"
RPI_EXTRA_CONFIG:append = "kernel=Image\n"

CMDLINE:append = " root=/dev/nvme0n1p2 rootwait quiet splash plymouth.ignore-serial-consoles loglevel=3 vt.global_cursor_default=0 logo.nologo"

WESTON_DISPLAYS:raspberrypi5 = " hdmi-a-1-90"
WESTON_DISPLAYS:raspberrypi5 = " hdmi-a-2-0"

BBMASK += ".*/python3-pydantic_1.10.9\.bb"

BBFILE_PRIORITY_meta-app = "999"
CORE_IMAGE_EXTRA_INSTALL += "plymouth"
WKS_FILE:forcevariable = "sdimage-nvme.wks"
INHERIT:remove = "create-spdx"

DISTRO_FEATURES:append = " vulkan"
EXTRA_OECONF:append:pn-rpidistro-ffmpeg = " \
    --disable-encoder=snow \
    --disable-decoder=snow \
    --disable-decoder=ayuv \
    --disable-decoder=v408 \
"


TOOLCHAIN_HOST_TASK:remove = "nativesdk-flutter-sdk"
TOOLCHAIN_HOST_TASK:append = " nativesdk-qtbase nativesdk-qtbase-tools"
TOOLCHAIN_TARGET_TASK:append = " qtdeclarative-dev qtdeclarative-tools qtbase-dev qtbase-tools "
IMAGE_INSTALL:remove:pn-agl-ivi-demo-qt-crosssdk = " kernel-devsrc kernel-dev "
```
